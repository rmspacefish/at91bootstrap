## board/at91sam9g20ek/at91sam9g20ek_nor_iobc_uboot_defconfig
```kconfig
CONFIG_AT91SAM9G20EK=y
CONFIG_FLASH=y
CONFIG_DEBUG=y
CONFIG_THUMB=y

# iOBC specific configuration
CONFIG_RAM_32MB=y
CONFIG_JUMP_ADDR="0x20000000"
CONFIG_IMG_ADDRESS="0x1000A000"
```
